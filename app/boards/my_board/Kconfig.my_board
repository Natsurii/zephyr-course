## app/boards/my_board/Kconfig.my_board
```kconfig
# Copyright (c) 2020 Kalyan Sriram
# SPDX-License-Identifier: Apache-2.0

config BOARD_BLACKPILL_F401CE
	bool "Blackpill F401CE Board"
	select SOC_STM32F401XE
```

## app/boards/my_board/board.yml
```yaml
board:
  name: my_board
  full_name: My custom board
  vendor: none
  socs:
    - name: stm32f401xe
```

## app/boards/our_board/board.yml
```yaml
board:
  name: our_board
  full_name: Black Pill V3.0
  vendor: weact
  socs:
    - name: stm32f401xe
```

## app/modules/led_sensor/drivers/our_driver/Kconfig
```kconfig
# LED sensor driver configuration options

# SPDX-License-Identifier: Apache-2.0

menuconfig OUR_DRIVER
	bool "Our Custom Driver (LED sensor)"
	default y
	depends on DT_HAS_OUR_DRIVER_ENABLED # Only if HW is present in the DT
	select GPIO                           # Auto-pulls dependencies
	select SENSOR
	help
	  Enable the custom sensor driver that drives an on-board LED.

	  sensor_sample_fetch() samples the pin level and sensor_channel_get()
	  turns the LED on or off accordingly. The extra API our_driver_toggle()
	  flips the LED and counts the toggles.

config OUR_DRIVER_SHELL
	bool "Our Custom Driver shell"
	depends on OUR_DRIVER
	select SHELL
	help
	  Add the "sensorroot" shell command to exercise the driver from a
	  serial console: "fetch" calls sensor_sample_fetch(), "read" calls
	  sensor_channel_get(), "info" prints the device name and ready state.
```

## app/modules/led_sensor/dts/bindings/driver/our,driver.yaml
```yaml
# SPDX-License-Identifier: Apache-2.0

description: |
  On-board LED exposed through the Zephyr Sensor API.

  sensor_sample_fetch() reads the current pin level into the driver data and
  sensor_channel_get() reports it through SENSOR_CHAN_PROX, driving the pin.
  Being a sensor device it needs no bus; the GPIO is taken from the node.

  Example:

    led_sensor: led_sensor {
        compatible = "our,driver";
        gpios = <&gpioc 13 GPIO_ACTIVE_LOW>;
        status = "okay";
    };

compatible: "our,driver"

include: sensor-device.yaml

properties:
  gpios:
    type: phandle-array
    required: true
    description: |
      The GPIO connected to the LED. The flags must describe the signal as it
      is presented to the LED (usually GPIO_ACTIVE_LOW for on-board LEDs wired
      to VDD through a resistor).

  callibration:
    type: int
    required: true
    description: |
      Number of GPIO writes the driver performs per LED update. Only used to
      show how a property is fetched with DT_INST_PROP().

  label:
    type: string
    description: Human readable name of the LED.
```
